/**
 * @file pet_display.c
 * @brief Pet OLED expression display
 *
 * Display layout (128x64):
 * ┌──────────────────────────────────────┐ 0
 * │ T:25°C H:60%   ♥88 🍔75 😴30        │ Status bar (16px)
 * ├──────────────────────────────────────┤ 16
 * │           ┌──────────┐               │
 * │           │  Face    │               │ Face area (40px)
 * │           │  32x32   │               │
 * │           └──────────┘               │
 * ├──────────────────────────────────────┤ 56
 * │ Feed  Play  Sleep  Mode              │ Button hints (8px)
 * └──────────────────────────────────────┘ 64
 */

#include "pet_display.h"
#include "pet_attributes.h"
#include "freertos/FreeRTOS.h"
#include "freertos/semphr.h"
#include "esp_log.h"
#include <stdio.h>

static const char *TAG = "PET_DISP";

static u8g2_t *s_u8g2 = NULL;
static SemaphoreHandle_t s_display_mutex = NULL;
static bool s_active = false;
static bool s_chart_mode = false;
static uint8_t s_chart_page = 0;  /* 0=H, 1=F, 2=T, 3=Temp, 4=Hum */
#define CHART_PAGE_COUNT 5

/* ============================================================================
 * Chart History Buffer (60 samples = 1 minute at 1 sample/sec)
 * ========================================================================== */
#define CHART_HISTORY_SIZE  60
#define CHART_X_START       12    /* left margin */
#define CHART_X_END         127   /* right edge */
#define CHART_Y_TOP         12    /* top of chart */
#define CHART_Y_BOTTOM      54    /* bottom of chart */

typedef struct {
    uint8_t happiness[CHART_HISTORY_SIZE];
    uint8_t hunger[CHART_HISTORY_SIZE];
    uint8_t fatigue[CHART_HISTORY_SIZE];
    int8_t  temperature[CHART_HISTORY_SIZE];  /* -40 to 80 range */
    uint8_t humidity[CHART_HISTORY_SIZE];
    uint8_t write_idx;
    uint8_t count;
} chart_history_t;

static chart_history_t s_history = {0};

/* 32x32 Face bitmaps (XBM format, stored in PROGMEM-like const) */

/* Happy face - big smile */
static const uint8_t face_happy[] = {
    0x00, 0xE0, 0x07, 0x00, 0x00, 0xFC, 0x3F, 0x00, 0x00, 0x1F, 0xF8, 0x00,
    0x80, 0x03, 0xC0, 0x01, 0xC0, 0x00, 0x00, 0x03, 0x60, 0x00, 0x00, 0x06,
    0x30, 0x00, 0x00, 0x0C, 0x18, 0x00, 0x00, 0x18, 0x0C, 0x00, 0x00, 0x30,
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    0x00, 0xE0, 0x07, 0x00, 0x00, 0x00, 0x00, 0x00
};

/* Normal face - simple smile */
static const uint8_t face_normal[] = {
    0x00, 0xE0, 0x07, 0x00, 0x00, 0xFC, 0x3F, 0x00, 0x00, 0x1F, 0xF8, 0x00,
    0x80, 0x03, 0xC0, 0x01, 0xC0, 0x00, 0x00, 0x03, 0x60, 0x00, 0x00, 0x06,
    0x30, 0x00, 0x00, 0x0C, 0x18, 0x00, 0x00, 0x18, 0x0C, 0x00, 0x00, 0x30,
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    0x00, 0xE0, 0x07, 0x00, 0x00, 0x00, 0x00, 0x00
};

/* Sad face - frown */
static const uint8_t face_sad[] = {
    0x00, 0xE0, 0x07, 0x00, 0x00, 0xFC, 0x3F, 0x00, 0x00, 0x1F, 0xF8, 0x00,
    0x80, 0x03, 0xC0, 0x01, 0xC0, 0x00, 0x00, 0x03, 0x60, 0x00, 0x00, 0x06,
    0x30, 0x00, 0x00, 0x0C, 0x18, 0x00, 0x00, 0x18, 0x0C, 0x00, 0x00, 0x30,
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    0x00, 0xE0, 0x07, 0x00, 0x00, 0x00, 0x00, 0x00
};

/* Hungry face - drooling */
static const uint8_t face_hungry[] = {
    0x00, 0xE0, 0x07, 0x00, 0x00, 0xFC, 0x3F, 0x00, 0x00, 0x1F, 0xF8, 0x00,
    0x80, 0x03, 0xC0, 0x01, 0xC0, 0x00, 0x00, 0x03, 0x60, 0x00, 0x00, 0x06,
    0x30, 0x00, 0x00, 0x0C, 0x18, 0x00, 0x00, 0x18, 0x0C, 0x00, 0x00, 0x30,
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    0x00, 0xE0, 0x07, 0x00, 0x00, 0x00, 0x00, 0x00
};

/* Tired face - droopy eyes */
static const uint8_t face_tired[] = {
    0x00, 0xE0, 0x07, 0x00, 0x00, 0xFC, 0x3F, 0x00, 0x00, 0x1F, 0xF8, 0x00,
    0x80, 0x03, 0xC0, 0x01, 0xC0, 0x00, 0x00, 0x03, 0x60, 0x00, 0x00, 0x06,
    0x30, 0x00, 0x00, 0x0C, 0x18, 0x00, 0x00, 0x18, 0x0C, 0x00, 0x00, 0x30,
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    0x00, 0xE0, 0x07, 0x00, 0x00, 0x00, 0x00, 0x00
};

/* Sick face - green-ish, tongue out */
static const uint8_t face_sick[] = {
    0x00, 0xE0, 0x07, 0x00, 0x00, 0xFC, 0x3F, 0x00, 0x00, 0x1F, 0xF8, 0x00,
    0x80, 0x03, 0xC0, 0x01, 0xC0, 0x00, 0x00, 0x03, 0x60, 0x00, 0x00, 0x06,
    0x30, 0x00, 0x00, 0x0C, 0x18, 0x00, 0x00, 0x18, 0x0C, 0x00, 0x00, 0x30,
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    0x00, 0xE0, 0x07, 0x00, 0x00, 0x00, 0x00, 0x00
};

/* Dead face - X eyes */
static const uint8_t face_dead[] = {
    0x00, 0xE0, 0x07, 0x00, 0x00, 0xFC, 0x3F, 0x00, 0x00, 0x1F, 0xF8, 0x00,
    0x80, 0x03, 0xC0, 0x01, 0xC0, 0x00, 0x00, 0x03, 0x60, 0x00, 0x00, 0x06,
    0x30, 0x00, 0x00, 0x0C, 0x18, 0x00, 0x00, 0x18, 0x0C, 0x00, 0x00, 0x30,
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    0x00, 0xE0, 0x07, 0x00, 0x00, 0x00, 0x00, 0x00
};

/* Get face bitmap for mood */
static const uint8_t *get_face_bitmap(pet_mood_t mood)
{
    switch (mood) {
        case PET_MOOD_HAPPY:  return face_happy;
        case PET_MOOD_NORMAL: return face_normal;
        case PET_MOOD_SAD:    return face_sad;
        case PET_MOOD_HUNGRY: return face_hungry;
        case PET_MOOD_TIRED:  return face_tired;
        case PET_MOOD_SICK:   return face_sick;
        case PET_MOOD_DEAD:   return face_dead;
        default:              return face_normal;
    }
}

esp_err_t pet_display_init(u8g2_t *u8g2, void *oled_mutex)
{
    if (!u8g2 || !oled_mutex) {
        return ESP_ERR_INVALID_ARG;
    }

    s_u8g2 = u8g2;
    s_display_mutex = (SemaphoreHandle_t)oled_mutex;

    s_active = true;

    ESP_LOGI(TAG, "Pet display initialized");
    return ESP_OK;
}

void pet_display_render(const pet_data_t *data, float temp, float humidity)
{
    if (!s_u8g2 || !data || !s_active) return;

    if (xSemaphoreTake(s_display_mutex, pdMS_TO_TICKS(100)) != pdTRUE) {
        return;
    }

    u8g2_ClearBuffer(s_u8g2);

    /* Row 1: Temperature & humidity (y=0-10) */
    u8g2_SetFont(s_u8g2, u8g2_font_6x13_tf);

    char status[40];
    snprintf(status, sizeof(status), "%.0fC %.0f%%", temp, humidity);
    u8g2_DrawStr(s_u8g2, 0, 11, status);

    /* Row 1 right: mood text */
    {
        const char *mood_cn = "";
        switch ((pet_mood_t)data->current_mood) {
            case PET_MOOD_HAPPY:  mood_cn = "Happy"; break;
            case PET_MOOD_NORMAL: mood_cn = "Good"; break;
            case PET_MOOD_SAD:    mood_cn = "Sad"; break;
            case PET_MOOD_HUNGRY: mood_cn = "Hungry"; break;
            case PET_MOOD_TIRED:  mood_cn = "Tired"; break;
            case PET_MOOD_SICK:   mood_cn = "Sick"; break;
            case PET_MOOD_DEAD:   mood_cn = "Dead"; break;
            default: break;
        }
        int w = u8g2_GetStrWidth(s_u8g2, mood_cn);
        u8g2_DrawStr(s_u8g2, 128 - w, 11, mood_cn);
    }

    /* Row 2: Pet attributes with labels (y=12-22)
     * H=Happiness  F=Hunger(Food)  T=Fatigue(Tired)
     */
    snprintf(status, sizeof(status), "H:%d F:%d T:%d",
             data->stats.happiness, data->stats.hunger, data->stats.fatigue);
    u8g2_DrawStr(s_u8g2, 0, 22, status);

    /* Separator line */
    u8g2_DrawHLine(s_u8g2, 0, 24, 128);

    /* Face area (centered, y=25-56) */
    const uint8_t *face = get_face_bitmap((pet_mood_t)data->current_mood);
    u8g2_DrawXBM(s_u8g2, 48, 25, 32, 32, face);

    /* Mode indicator */
    if (data->speed_mode == PET_MODE_FAST) {
        u8g2_SetFont(s_u8g2, u8g2_font_6x13_tf);
        u8g2_DrawStr(s_u8g2, 92, 55, "FAST");
    } else if (data->speed_mode == PET_MODE_PAUSE) {
        u8g2_SetFont(s_u8g2, u8g2_font_6x13_tf);
        u8g2_DrawStr(s_u8g2, 86, 55, "PAUSE");
    }

    /* Button hints (y=57-63) */
    u8g2_DrawHLine(s_u8g2, 0, 56, 128);
    u8g2_SetFont(s_u8g2, u8g2_font_5x8_tf);
    u8g2_DrawStr(s_u8g2, 2, 64, "Feed");
    u8g2_DrawStr(s_u8g2, 34, 64, "Play");
    u8g2_DrawStr(s_u8g2, 66, 64, "Rest");
    u8g2_DrawStr(s_u8g2, 98, 64, "Mode");

    u8g2_SendBuffer(s_u8g2);

    xSemaphoreGive(s_display_mutex);
}

bool pet_display_is_active(void)
{
    return s_active;
}

void pet_display_set_active(bool enable)
{
    s_active = enable;
    ESP_LOGI(TAG, "Pet display %s", enable ? "enabled" : "disabled");
}

bool pet_display_is_chart_mode(void)
{
    return s_chart_mode;
}

void pet_display_toggle_chart_mode(void)
{
    s_chart_mode = !s_chart_mode;
    if (s_chart_mode) {
        s_chart_page = 0;  /* Reset to first page when entering */
    }
    ESP_LOGI(TAG, "Chart mode %s", s_chart_mode ? "enabled" : "disabled");
}

void pet_display_next_chart_page(void)
{
    s_chart_page = (s_chart_page + 1) % CHART_PAGE_COUNT;
    ESP_LOGI(TAG, "Chart page: %d", s_chart_page);
}

void pet_display_record_data(const pet_data_t *data, float temp, float humidity)
{
    if (!data) return;

    uint8_t idx = s_history.write_idx;

    s_history.happiness[idx] = data->stats.happiness;
    s_history.hunger[idx] = data->stats.hunger;
    s_history.fatigue[idx] = data->stats.fatigue;
    s_history.temperature[idx] = (int8_t)temp;
    s_history.humidity[idx] = (uint8_t)humidity;

    s_history.write_idx = (s_history.write_idx + 1) % CHART_HISTORY_SIZE;
    if (s_history.count < CHART_HISTORY_SIZE) {
        s_history.count++;
    }
}

/**
 * @brief Draw curve - connects all points with lines
 */
static void draw_curve(const uint8_t *data, uint8_t count, uint8_t write_idx,
                       uint8_t min_val, uint8_t max_val)
{
    if (count < 2) return;

    int chart_w = CHART_X_END - CHART_X_START;
    int chart_h = CHART_Y_BOTTOM - CHART_Y_TOP;
    int range = max_val - min_val;
    if (range == 0) range = 1;

    int prev_x = -1, prev_y = -1;

    for (int i = 0; i < count; i++) {
        int read_idx = (write_idx - count + i + CHART_HISTORY_SIZE) % CHART_HISTORY_SIZE;
        int val = data[read_idx];

        /* Clamp value */
        if (val < min_val) val = min_val;
        if (val > max_val) val = max_val;

        int x = CHART_X_START + (i * chart_w / (count - 1));
        int y = CHART_Y_BOTTOM - ((val - min_val) * chart_h / range);

        /* Draw point */
        u8g2_DrawPixel(s_u8g2, x, y);

        /* Connect to previous point */
        if (prev_x >= 0) {
            u8g2_DrawLine(s_u8g2, prev_x, prev_y, x, y);
        }

        prev_x = x;
        prev_y = y;
    }
}

/**
 * @brief Draw temperature curve (int8_t data)
 */
static void draw_temp_curve(const int8_t *data, uint8_t count, uint8_t write_idx,
                            int min_val, int max_val)
{
    if (count < 2) return;

    int chart_w = CHART_X_END - CHART_X_START;
    int chart_h = CHART_Y_BOTTOM - CHART_Y_TOP;
    int range = max_val - min_val;
    if (range == 0) range = 1;

    int prev_x = -1, prev_y = -1;

    for (int i = 0; i < count; i++) {
        int read_idx = (write_idx - count + i + CHART_HISTORY_SIZE) % CHART_HISTORY_SIZE;
        int val = data[read_idx];

        if (val < min_val) val = min_val;
        if (val > max_val) val = max_val;

        int x = CHART_X_START + (i * chart_w / (count - 1));
        int y = CHART_Y_BOTTOM - ((val - min_val) * chart_h / range);

        u8g2_DrawPixel(s_u8g2, x, y);

        if (prev_x >= 0) {
            u8g2_DrawLine(s_u8g2, prev_x, prev_y, x, y);
        }

        prev_x = x;
        prev_y = y;
    }
}

void pet_display_render_chart(void)
{
    if (!s_u8g2 || !s_active || !s_chart_mode) return;

    if (xSemaphoreTake(s_display_mutex, pdMS_TO_TICKS(100)) != pdTRUE) {
        return;
    }

    u8g2_ClearBuffer(s_u8g2);

    uint8_t count = s_history.count;
    uint8_t write_idx = s_history.write_idx;
    int latest_idx = count > 0 ? (write_idx - 1 + CHART_HISTORY_SIZE) % CHART_HISTORY_SIZE : 0;

    /* Simple title: name:value (page/total) */
    char title[24];
    u8g2_SetFont(s_u8g2, u8g2_font_6x13_tf);

    switch (s_chart_page) {
        case 0:
            snprintf(title, sizeof(title), "H:%d (1/5)",
                     count > 0 ? s_history.happiness[latest_idx] : 0);
            break;
        case 1:
            snprintf(title, sizeof(title), "F:%d (2/5)",
                     count > 0 ? s_history.hunger[latest_idx] : 0);
            break;
        case 2:
            snprintf(title, sizeof(title), "T:%d (3/5)",
                     count > 0 ? s_history.fatigue[latest_idx] : 0);
            break;
        case 3:
            snprintf(title, sizeof(title), "Temp:%dC (4/5)",
                     count > 0 ? s_history.temperature[latest_idx] : 0);
            break;
        case 4:
            snprintf(title, sizeof(title), "Hum:%d%% (5/5)",
                     count > 0 ? s_history.humidity[latest_idx] : 0);
            break;
        default:
            snprintf(title, sizeof(title), "?");
            break;
    }
    u8g2_DrawStr(s_u8g2, 0, 10, title);

    /* Draw axes */
    u8g2_DrawHLine(s_u8g2, CHART_X_START, CHART_Y_BOTTOM, CHART_X_END - CHART_X_START);
    u8g2_DrawVLine(s_u8g2, CHART_X_START, CHART_Y_TOP, CHART_Y_BOTTOM - CHART_Y_TOP);

    /* Draw curve */
    if (count >= 2) {
        switch (s_chart_page) {
            case 0:
                draw_curve(s_history.happiness, count, write_idx, 0, 100);
                break;
            case 1:
                draw_curve(s_history.hunger, count, write_idx, 0, 100);
                break;
            case 2:
                draw_curve(s_history.fatigue, count, write_idx, 0, 100);
                break;
            case 3:
                draw_temp_curve(s_history.temperature, count, write_idx, 0, 50);
                break;
            case 4:
                draw_curve(s_history.humidity, count, write_idx, 0, 100);
                break;
        }
    }

    /* Bottom labels */
    u8g2_SetFont(s_u8g2, u8g2_font_5x8_tf);
    u8g2_DrawStr(s_u8g2, 0, 64, "-60s");
    u8g2_DrawStr(s_u8g2, 108, 64, "now");

    u8g2_SendBuffer(s_u8g2);
    xSemaphoreGive(s_display_mutex);
}
